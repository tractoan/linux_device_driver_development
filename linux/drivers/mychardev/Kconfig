## linux/drivers/mychardev/Kconfig
```kconfig
config MYCDEV
    tristate "Toannguyenkt69 special Character driver"
    default m
    help
        Say Y here if you want to support the /dev/mycdev device.
        The /dev/mycdev device is used to access mycdev.
```
